## conf/distro/ai-nas.conf
```bitbake
# AI-NAS 发行版配置
# 继承自 poky，使用 systemd + glibc，面向 NAS + AI 推理场景

require conf/distro/poky.conf

# Override DISTRO — poky.conf 使用硬赋值 (=) 会覆盖 kas/local.conf 的设置
DISTRO = "ai-nas"

DISTRO_NAME = "AI-NAS"
DISTRO_VERSION = "1.0.0"
DISTRO_CODENAME = "ai-nas"

# ── 核心组件 ─────────────────────────────────────────────────

# 使用 systemd（覆盖 poky.conf 的 ?= sysvinit）
# defaultsetup.conf 已通过 ??= "systemd" 加载了 init-manager-systemd.inc，
# 这里用硬赋值确保最终值与加载的 inc 一致
INIT_MANAGER = "systemd"

# 使用 glibc（默认值，显式声明以明确与 tinyai 的 musl 区分）
TCLIBC = "glibc"

# ── NAS 相关特性 ─────────────────────────────────────────────

# 文件系统支持：btrfs（快照/RAID）、xfs（大容量存储）
DISTRO_FEATURES:append = " btrfs xfs"

# 网络存储协议
# nfs — NFS 客户端/服务端支持（通过 DISTRO_FEATURES 触发对应 recipe 开关）
# 注意：samba 和 nfs 通常通过 IMAGE_INSTALL 添加 recipe 而非 DISTRO_FEATURES
DISTRO_FEATURES:append = " wifi"

# ── AI 相关特性 ──────────────────────────────────────────────

# 保留 AI 推理支持（通过 recipes-support 中的 llama.cpp 等提供）
# AI 推理引擎通过 IMAGE_INSTALL 添加，不在 DISTRO_FEATURES 层面控制

# ── 系统组件 ─────────────────────────────────────────────────

# 使用 systemd 的 udev 作为设备管理器（由 init-manager-systemd.inc 设置）
VIRTUAL-RUNTIME_dev_manager = "systemd"

# 使用 systemd-networkd 管理网络（轻量，无需额外依赖）
# 可在 IMAGE_INSTALL 中添加 systemd-networkd 或 NetworkManager

# 登录管理器使用 shadow（提供完善的用户/权限管理，适合 NAS 多用户场景）
# （由 init-manager-systemd.inc 设置为 shadow-base）
VIRTUAL-RUNTIME_login_manager = "shadow-base"
```

## conf/distro/tinyai.conf
```bitbake
# TinyAI 发行版配置
# 继承自 poky，默认包含 llama-cpp（LLM 推理引擎）

require conf/distro/poky.conf

# Override DISTRO back to "tinyai" — poky.conf uses hard assignment (=) that
# would otherwise override whatever kas set in local.conf
DISTRO = "tinyai"

DISTRO_NAME = "TinyAI"
DISTRO_VERSION = "1.0.0"
DISTRO_CODENAME = "tinyai"

# 使用 OpenRC（覆盖上游 defaultsetup.conf 中的 "systemd" 以及 poky.conf 的 ?=）
INIT_MANAGER = "openrc"

# init-manager-*.inc 已在 defaultsetup.conf 中提前加载（只用了 ??=），
# 这里用硬 = 覆盖，确保 OpenRC 的 VIRTUAL-RUNTIME 生效。
DISTRO_FEATURES:append = " openrc"
DISTRO_FEATURES_OPTED_OUT:append = " sysvinit systemd"
VIRTUAL-RUNTIME_init_manager = "openrc-init"
VIRTUAL-RUNTIME_initscripts = "openrc"
VIRTUAL-RUNTIME_login_manager = "busybox"
VIRTUAL-RUNTIME_keymaps = "openrc"
VIRTUAL-RUNTIME_base-utils-hwclock = "openrc"

# 使用 musl libc（减少体积，适合嵌入式）
TCLIBC = "musl"

# 使用 mdev（busybox 内置）作为设备管理器——轻量、无守护进程、无需 udev
# 与 Alpine Linux 策略一致。显式设定以覆盖任何上游默认值。
VIRTUAL-RUNTIME_dev_manager = "busybox-mdev"

# 启用 WiFi 支持（使依赖 DISTRO_FEATURES 的 recipe 能按需开启 wifi 功能）
DISTRO_FEATURES:append = " wifi"
```

## conf/layer.conf
```bitbake
# 1. 让 BitBake 能找到这个层
BBPATH .= ":${LAYERDIR}"

# 2. 告诉 BitBake 解析哪些配方文件
BBFILES += "${LAYERDIR}/recipes-*/*/*.bb"

# 3. 动态加载 bbappend（仅在对应层存在时加载）
BBFILES_DYNAMIC += "meta-poky:${LAYERDIR}/recipes-core/tiny-init/*.bbappend"
BBFILES_DYNAMIC += "raspberrypi:${LAYERDIR}/recipes-kernel/linux/*.bbappend"

# 4. 给这个层起个名字叫 "embedlab"
BBFILE_COLLECTIONS += "embedlab"

# 5. 匹配规则：路径以层目录开头的文件都属于 embedlab 层
BBFILE_PATTERN_embedlab = "^${LAYERDIR}/"

# 6. 优先级设为 6（高于默认的 5）
BBFILE_PRIORITY_embedlab = "6"

# 7. 这个层依赖 OE-Core 的 meta 层
LAYERDEPENDS_embedlab = "core"

# 8. 兼容 Yocto 最新版本 (master/wrynose)
LAYERSERIES_COMPAT_embedlab = "wrynose"

# 9. 自定义变量：产品版本号
EMBEDLAB_VERSION = "1.0.0"
```
